// Thanks, Technoblogy
// - http://www.technoblogy.com/show?23OS

// heavily modified to support ATtiny84 and add some new features,
// as well as optimize the hell out of anything already here

#include <Wire.h>
#include <avr/io.h>
#include <avr/pgmspace.h>
#include <stdlib.h>
#include <Arduino.h>
#include "monochrome-spritesheet.hh"

/* Tiny Graphics Library v3 - see http://www.technoblogy.com/show?23OS

   David Johnson-Davies - www.technoblogy.com - 23rd September 2018
   ATtiny85 @ 8 MHz (internal oscillator; BOD disabled)

   CC BY 4.0
   Licensed under a Creative Commons Attribution 4.0 International license:
   http://creativecommons.org/licenses/by/4.0/
*/


// Pins
int const sda = 6;
int const scl = 4;

// Constants
int const address = 60;
int const commands = 0x00;
int const onecommand = 0x80;
int const data = 0x40;
int const onedata = 0xC0;

// OLED display **********************************************

// Character set for text - stored in program memory
// 6 columns of 8
const uint8_t CharMap[96][6] PROGMEM = {
  { 0x00, 0x00, 0x00, 0x00, 0x00, 0x00 },
  { 0x00, 0x00, 0x5F, 0x00, 0x00, 0x00 },
  { 0x00, 0x07, 0x00, 0x07, 0x00, 0x00 },
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  { 0xFF, 0xFF, 0xFF, 0xFF, 0xFF, 0x00 }

};

// Current plot position
int x0;
int y0;

// Write a single command
void Single(uint8_t x) {
  Wire.write(onecommand);
  Wire.write(x);
}

void InitI2C(){
  Wire.begin();
}

void InitDisplay() {
  Wire.beginTransmission(address);
  Wire.write(commands);
  Wire.write(0xA1);  // Flip horizontal
  Wire.write(0xAF);  // Display on
  Wire.endTransmission();
}

void ClearDisplay() {
  for (int p = 0; p < 8; p++) {
    Wire.beginTransmission(address);
    Single(0xB0 + p);
    Wire.endTransmission();
    for (int q = 0; q < 8; q++) {
      Wire.beginTransmission(address);
      Wire.write(data);
      for (int i = 0; i < 20; i++) Wire.write(0);
      Wire.endTransmission();
    }
  }
}

void setupDisplay(){
    InitI2C();
    ClearDisplay();
    InitDisplay();
}

// Plot point x,y into buffer if in current slice
void PlotPoint(int x, int y) {
  Wire.beginTransmission(address);
  Single(0x00 + ((x + 2) & 0x0F));  // Column low nibble
  Single(0x10 + ((x + 2) >> 4));    // Column high nibble
  Single(0xB0 + (y >> 3));          // Page
  Single(0xE0);                     // Read modify write
  Wire.write(onedata);
  Wire.endTransmission();
  Wire.requestFrom(address, 2);
  Wire.read();  // Dummy read
  int j = Wire.read();
  Wire.beginTransmission(address);
  Wire.write(onedata);
  Wire.write((1 << (y & 0x07)) | j);
  Single(0xEE);  // Cancel read modify write
  Wire.endTransmission();
}

// Move current plot position to x,y
void MoveTo(int x, int y) {
  x0 = x;
  y0 = y;
}

// Draw a line to x,y
void DrawTo(int x, int y) {
  int sx, sy, e2, err;
  int dx = abs(x - x0);
  int dy = abs(y - y0);
  if (x0 < x) sx = 1;
  else sx = -1;
  if (y0 < y) sy = 1;
  else sy = -1;
  err = dx - dy;
  for (;;) {
    PlotPoint(x0, y0);
    if (x0 == x && y0 == y) return;
    e2 = err << 1;
    if (e2 > -dy) {
      err = err - dy;
      x0 = x0 + sx;
    }
    if (e2 < dx) {
      err = err + dx;
      y0 = y0 + sy;
    }
  }
}

uint8_t ReverseByte(uint8_t x) {
  x = ((x >> 1) & 0x55) | ((x << 1) & 0xaa);
  x = ((x >> 2) & 0x33) | ((x << 2) & 0xcc);
  x = ((x >> 4) & 0x0f) | ((x << 4) & 0xf0);
  return x;
}

// Plot an ASCII character with bottom left corner at x,y
// only supports y divisible by 8, hence page instead of y
void PlotChar(int c, int x, int page) {
  Wire.beginTransmission(address);
  Single(0xB0 + page);
  // column is automatically incremented on display memory accessses so no need to keep re-setting it
  Single(0x00 + ((x + 2) & 0x0F));  // initial Column low nibble
  Single(0x10 + ((x + 2) >> 4));    // initial Column high nibble
  Single(0xE0);                           // Read modify write
  for (int col = 0; col < 6; col++) {
    Wire.write(onedata);
    Wire.write(
       ReverseByte( // reverse the sprite maps instead
        pgm_read_byte(&CharMap[c - 32][col])
         )
        );
  }
  Single(0xEE);  // Cancel read modify write
  Wire.endTransmission();
}

// Plot text starting at the current plot position
void PlotText(PGM_P s) {
  int p = (int) s;
  while (1) {
    char c = pgm_read_byte(p++);
    if (c == 0) return;
    PlotChar(c, x0, y0 >> 3);
    x0 = x0 + 6;
  }
}

void invert(){
  Wire.beginTransmission(address);
  Single(0xA7); // inverse display output
  Wire.endTransmission();
}

void unInvert(){
  Wire.beginTransmission(address);
  Single(0xA6);
  Wire.endTransmission();
}

// the above 2 in a row
void blink(){
  invert();
  delay(100);
  unInvert();
}


// these disregard the "invert" state
void forceDisplayAllOff(){
  Wire.beginTransmission(address);
  Single(0xAE); // turn display off - overrides any other command effect
  Wire.endTransmission();
}

void forceDisplayAllOn(){
  Wire.beginTransmission(address);
  Single(0xA5); // force all segments on
  Wire.endTransmission();
}

void resetForceDisplay(){
  Wire.beginTransmission(address);
  Single(0xA4); // undo force all segments on
  Single(0xAF); // turn display back on
  Wire.endTransmission();
}
// contrast but for OLEDs
// default is 1 << 7
void setBrightness(uint8_t brightness){ 
  Wire.beginTransmission(address);
  Single(0x81); // enable contrast control mode
  Single(brightness); // send it, and exit contrast control mode
  Wire.endTransmission();
}

void resetBrightness(){
  setBrightness(1 << 7);
}

// max lines = 63 !!
// loops the display ram across the display with this offset
void setScroll(uint8_t lines){
  Wire.beginTransmission(address);
  Single(0x40 | (lines & 0x3F));
  Wire.endTransmission();
}

void resetScroll(){
  setScroll(0);
}